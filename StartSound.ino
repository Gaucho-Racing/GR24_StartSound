// ========== Info ==========
// GR24 startup sound firmware
// Target platform: ATmega32U4
// Board settings: Arduino Micro

const uint8_t audio[] PROGMEM = {126, 126, 126, 126, 126, 126, 126, 126, 126, 126, 126, 126, 127,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 127, 127};
const uint16_t audioLen = 12539;
const uint16_t sampleTime = 1e6 / 8000;
uint16_t currPos = 0;

void setup() {
  // put your setup code here, to run once:
  DDRD = 0xFF; // all port D to output
  PORTD = 0; // all outputs low
  pinMode(7, INPUT); // audio start signal, PE6
}

bool lastRead = false;
bool thisRead;
uint32_t now;
bool playing = false;
uint32_t lastWriteTime = 0;

void loop() {
  // put your main code here, to run repeatedly:
  now = micros();
  thisRead = digitalRead(7);
  if (thisRead & !lastRead) { // start playing on rising edge
    currPos = 0;
    playing = true;
  }
  else if (!thisRead & lastRead) { // stop on falling edge
    playing = false;
  }
  lastRead = thisRead;
  
  if (playing) {
    if (now - lastWriteTime >= sampleTime) {
      lastWriteTime = now;
      PORTD = pgm_read_byte_near(audio + currPos);
      currPos++;
      if (currPos >= audioLen) playing = false; // stop playing at end of audio
    }
  }
  else {
    PORTD = 0;
  }
}
